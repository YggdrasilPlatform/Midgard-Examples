# file: Mandelbrot.ioc
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PF4.Mode=IN14
VP_ADC1_TempSens_Input.Mode=IN-TempSens
TIM3.Channel-Output\ Compare3\ CH3=TIM_CHANNEL_3
DSIHOST_D0N.Mode=DSIHost_Video
PG0.Signal=GPIO_Output
SAI1.Instance-SAI_A_MasterWithClock=SAI$Index_Block_A
PI15.GPIO_Label=SUB_NRST
CORTEX_M7.IsShareable-Cortex_Memory_Protection_Unit_Region4_Settings=MPU_ACCESS_SHAREABLE
PG10.GPIO_PuPd=GPIO_PULLUP
DSIHOST_D0P.Signal=DSIHOST_D0P
CORTEX_M7.Enable-Cortex_Memory_Protection_Unit_Region0_Settings=MPU_REGION_ENABLE
CORTEX_M7.IsBufferable-Cortex_Memory_Protection_Unit_Region1_Settings=MPU_ACCESS_BUFFERABLE
PF7.Signal=QUADSPI_BK1_IO2
RCC.PLL48CLockSelection=RCC_CLK48SOURCE_PLLSAIP
PH9.Signal=DCMI_D0
RCC.APB2TimFreq_Value=216000000
PB6.Signal=I2C1_SCL
PC7.Signal=S_TIM3_CH2
PD0.Signal=UART4_RX
PD8.Signal=GPIO_Output
PE1.Signal=UART8_TX
TIM4.Channel-PWM\ Generation3\ CH3=TIM_CHANNEL_3
PB3.Mode=Trace_Asynchronous_SW
PK4.GPIO_Label=BTN0
DSIHOST.HorizontalLine=1994
PG14.Mode=RMII
SH.S_TIM12_CH1.0=TIM12_CH1,PWM Generation1 CH1
PE9.Signal=QUADSPI_BK2_IO2
DSIHOST_D1N.Signal=DSIHOST_D1N
PB1.GPIO_Label=GPIO3
PG4.GPIO_Label=SEG_E
PC9.Mode=I2C
PA8.Signal=I2C3_SCL
PE13.Mode=Full_Duplex_Master
CORTEX_M7.Size-Cortex_Memory_Protection_Unit_Region4_Settings=MPU_REGION_SIZE_128KB
PJ14.Signal=GPIO_Output
Mcu.Package=LQFP208
PB9.Signal=S_TIM11_CH1
PB1.Signal=S_TIM3_CH4
PH12.Mode=Slave_12_bits_External_Synchro
SPI2.Mode=SPI_MODE_MASTER
PD12.Signal=S_TIM4_CH1
PH11.Mode=Slave_12_bits_External_Synchro
PA10.Signal=GPIO_Output
CORTEX_M7.BaseAddress-Cortex_Memory_Protection_Unit_Region4_Settings=0x20060000
PC11.Mode=Enable Chip Select for each bank
SPI5.CalculateBaudRate=6.75 MBits/s
RCC.APB2CLKDivider=RCC_HCLK_DIV2
SH.S_TIM4_CH1.0=TIM4_CH1,PWM Generation1 CH1
PI7.Mode=Slave_12_bits_External_Synchro
RCC.APB1TimFreq_Value=108000000
DSIHOST.HorizontalBackPorch=80
PF10.Mode=Dual_Bank
PB13.Mode=CAN_Activate
PH8.Mode=Slave_12_bits_External_Synchro
TIM4.Channel-PWM\ Generation4\ CH4=TIM_CHANNEL_4
PD15.Signal=S_TIM4_CH4
PJ1.GPIO_Label=LD1
PE12.Mode=Full_Duplex_Master
PI5.GPIO_PuPd=GPIO_PULLUP
CORTEX_M7.AccessPermission-Cortex_Memory_Protection_Unit_Region3_Settings=MPU_REGION_FULL_ACCESS
CAN2.CalculateBaudRate=675000
PK4.Signal=GPIO_Input
PH13.Signal=UART4_TX
SAI1.MClockEnable-SAI_A_MasterWithClock=SAI_MASTERCLOCK_ENABLE
PG5.Signal=GPIO_Output
PC13.Signal=GPIO_Input
PI6.GPIO_PuPd=GPIO_PULLUP
PD3.Signal=USART2_CTS
PG9.Mode=Slave_12_bits_External_Synchro
PC2.Signal=SPI2_MISO
PI12.Signal=GPIO_Output
SAI1.ErrorAudioFreq-SAI_A_MasterWithClock=-2.34 %
PD6.Mode=Asynchronous
DSIHOST.Mode=DSI_VID_MODE_BURST
PD10.Signal=GPIO_Output
PF11.Mode=Full_Duplex_Master
PJ3.Signal=GPIO_Output
PI8.GPIO_Label=ICM_42605_INT1
CORTEX_M7.ART_ACCLERATOR_ENABLE=1
PH9.Mode=Slave_12_bits_External_Synchro
SAI1.VirtualMode-SAI_A_MasterWithClock=VM_MASTER
PB14.Signal=S_TIM12_CH1
PA5.Signal=COMP_DAC2_group
CORTEX_M7.Enable-Cortex_Memory_Protection_Unit_Region2_Settings=MPU_REGION_ENABLE
PC12.Mode=Asynchronous
SH.S_TIM8_CH1.0=TIM8_CH1,Encoder_Interface
PK7.GPIO_Label=BTN3
PI7.Signal=DCMI_D7
PE14.Signal=SPI4_MOSI
PE6.Mode=SAI_A_MasterWithClock
PG7.GPIO_Label=SEG_DP
PI2.Signal=DCMI_D9
PJ15.GPIO_Label=SEG_SEL3
TIM3.Channel-Output\ Compare4\ CH4=TIM_CHANNEL_4
PC7.GPIO_Label=GPIO0
ADC3.Rank-1\#ChannelRegularConversion=1
ETH.MediaInterface=ETH_MEDIA_INTERFACE_RMII
ADC1.master=1
ADC2.NbrOfConversionFlag=1
PJ0.GPIO_Label=LD0
ProjectManager.HeapSize=0x200
PH6.Signal=SPI5_SCK
DSIHOST.FrameBTAAcknowledgeEnable=DSI_FBTAA_DISABLE
SPI4.CLKPhase=SPI_PHASE_2EDGE
CORTEX_M7.DisableExec-Cortex_Memory_Protection_Unit_Region2_Settings=MPU_INSTRUCTION_ACCESS_ENABLE
NVIC.PriorityGroup=NVIC_PRIORITYGROUP_4
PI11.GPIO_Label=RV_3028_C7_INT
PE3.Signal=SAI1_SD_B
PC15/OSC32_OUT.Signal=RCC_OSC32_OUT
PF4.Signal=ADC3_IN14
PD2.Signal=UART5_RX
PC1.Mode=RMII
DSIHOST.LPVerticalSyncActiveEnable=DSI_LP_VSYNC_ENABLE
Mcu.Family=STM32F7
PA6.Mode=Slave_12_bits_External_Synchro
PK3.Signal=GPXTI3
RCC.PLLDSIIDF=DSI_PLL_IN_DIV6
PH14.Signal=DCMI_D4
PH10.Signal=DCMI_D1
PG2.Signal=GPIO_Output
CAN2.CalculateTimeBit=1481.48
PA11.Mode=CAN_Activate
PC14/OSC32_IN.Mode=LSE-External-Oscillator
PG5.GPIO_Label=SEG_F
PB15.Signal=SPI2_MOSI
PJ5.GPIO_Label=uSDDETECT
PG11.Signal=GPIO_Input
PJ14.GPIO_Label=SEG_SEL2
CORTEX_M7.IsBufferable-Cortex_Memory_Protection_Unit_Region3_Settings=MPU_ACCESS_BUFFERABLE
SH.COMP_DAC2_group.0=DAC_OUT2,DAC_OUT2
CORTEX_M7.IsShareable-Cortex_Memory_Protection_Unit_Region2_Settings=MPU_ACCESS_SHAREABLE
PD13.Signal=S_TIM4_CH2
PJ2.Signal=GPIO_Output
SAI1.VirtualMode-SAI_B_SyncSlave=VM_SLAVE
SH.ADCx_IN3.0=ADC1_IN3,IN3
PH10.Mode=Slave_12_bits_External_Synchro
SPI5.CLKPolarity=SPI_POLARITY_HIGH
PD5.Mode=Asynchronous
TIM3.Channel-PWM\ Generation1\ CH1=TIM_CHANNEL_1
ADC1.Channel-0\#ChannelRegularConversion=ADC_CHANNEL_3
RCC.HSE_VALUE=24000000
CORTEX_M7.Size-Cortex_Memory_Protection_Unit_Region2_Settings=MPU_REGION_SIZE_128KB
PF9.Mode=Dual_Bank
DSIHOST.LPHorizontalFrontPorchEnable=DSI_LP_HFP_ENABLE
PA14.Mode=Trace_Asynchronous_SW
PF11.Signal=SPI5_MOSI
DSIHOST_D1P.Signal=DSIHOST_D1P
PJ12.GPIO_Label=SEG_SEL0
PB7.Signal=I2C1_SDA
DSIHOST.BTA_FlowControl=__NULL
SH.S_TIM3_CH1.0=TIM3_CH1,PWM Generation1 CH1
DSIHOST.LPVACTLargestPacketSize=8
PA6.Signal=DCMI_PIXCLK
PB12.Mode=CAN_Activate
CAN2.BS1=CAN_BS1_2TQ
CAN2.BS2=CAN_BS2_2TQ
PA15.Signal=SYS_JTDI
PG0.GPIO_Label=SEG_A
PF8.Signal=QUADSPI_BK1_IO0
ADC2.SamplingTime-0\#ChannelRegularConversion=ADC_SAMPLETIME_3CYCLES
PI0.GPIO_Label=SPI2_CE
PI1.Mode=Slave_12_bits_External_Synchro
CORTEX_M7.Size-Cortex_Memory_Protection_Unit_Region1_Settings=MPU_REGION_SIZE_2MB
I2C3.Timing=0x20404768
PB5.GPIO_Label=JACK
DSIHOST_CKN.Signal=DSIHOST_CKN
SH.S_TIM5_CH1.0=TIM5_CH1,PWM Generation1 CH1
PG11.GPIO_Label=BTN_JS1
PC5.Signal=ETH_RXD1
PE7.Signal=QUADSPI_BK2_IO0
PD6.Signal=USART2_RX
SH.S_TIM11_CH1.0=TIM11_CH1,PWM Generation1 CH1
CORTEX_M7.IsShareable-Cortex_Memory_Protection_Unit_Region1_Settings=MPU_ACCESS_SHAREABLE
DSIHOST_D0P.Mode=DSIHost_Video
PB4.Signal=SYS_JTRST
PG2.GPIO_Label=SEG_C
PA3.Signal=ADCx_IN3
PK6.Signal=GPIO_Input
SH.ADCx_IN13.0=ADC2_IN13,IN13
PG7.Signal=GPIO_Output
SPI4.DataSize=SPI_DATASIZE_8BIT
PC11.Signal=QUADSPI_BK2_NCS
PI14.Signal=GPIO_Output
PC2.Mode=Full_Duplex_Master
PD9.Signal=GPIO_Output
SH.S_TIM3_CH3.0=TIM3_CH3,PWM Generation3 CH3
SPI5.Mode=SPI_MODE_MASTER
CORTEX_M7.BaseAddress-Cortex_Memory_Protection_Unit_Region2_Settings=0x20000000
PF5.Mode=IN15
PD8.GPIO_Label=CAN_FD_STBY
PA13.Signal=SYS_JTMS-SWDIO
DSIHOST.LPHorizontalBackPorchEnable=DSI_LP_HBP_ENABLE
CORTEX_M7.MPU_Control=MPU_PRIVILEGED_DEFAULT
SAI1.RealAudioFreq-SAI_A_MasterWithClock=187.5 KHz
PA9.Mode=Full_Duplex_Master
CAN1.BS2=CAN_BS2_2TQ
PF6.Signal=QUADSPI_BK1_IO3
CAN1.BS1=CAN_BS1_2TQ
PH8.Signal=DCMI_HSYNC
SH.S_TIM4_CH3.0=TIM4_CH3,PWM Generation3 CH3
RCC.USBFreq_Value=48000000
PH13.Mode=Asynchronous
PD10.GPIO_Label=DSI_TE
DSIHOST.GCEIE=HAL_DSI_ERROR_NONE
PA1.Signal=ETH_REF_CLK
PD2.Mode=Asynchronous
DSIHOST_CKP.Signal=DSIHOST_CKP
SPI5.VirtualNSS=VM_NSSHARD
board=custom
RCC.VCOOutputFreq_Value=432000000
PI9.Signal=GPIO_Input
PB15.Mode=Full_Duplex_Master
TIM12.Channel-PWM\ Generation1\ CH1=TIM_CHANNEL_1
PI13.GPIO_Label=TC78H660FTG_ERR
RCC.PLLDSINDIV=125
PI4.Signal=DCMI_D5
PF14.Mode=I2C
PE5.Mode=SAI_A_MasterWithClock
DSIHOST.LPCommandEnable=DSI_LP_COMMAND_ENABLE
PF1.Signal=I2C2_SCL
PJ0.Signal=GPIO_Output
PE0.Signal=UART8_RX
PE12.Signal=SPI4_SCK
CORTEX_M7.IsCacheable-Cortex_Memory_Protection_Unit_Region1_Settings=MPU_ACCESS_CACHEABLE
RCC.SYSCLKFreq_VALUE=216000000
PJ5.Signal=GPIO_Input
DSIHOST.LPVerticalBackPorchEnable=DSI_LP_VBP_ENABLE
CORTEX_M7.Enable-Cortex_Memory_Protection_Unit_Region3_Settings=MPU_REGION_ENABLE
RCC.HSI_VALUE=16000000
RCC.PLLQ=8
RCC.PLLM=24
RCC.PLLN=432
TIM11.Channel=TIM_CHANNEL_1
PA2.Mode=RMII
PH5.Mode=NSS_Signal_Hard_Output
CORTEX_M7.CPU_DCache=Enabled
PJ2.GPIO_Label=LD2
ADC3.NbrOfConversionFlag=1
VP_CRC_VS_CRC.Mode=CRC_Activate
RCC.PLLI2SN=50
PB12.Signal=CAN2_RX
PJ13.Signal=GPIO_Output
PK5.Signal=GPIO_Input
SPI4.VirtualType=VM_MASTER
PH12.Signal=DCMI_D3
SPI2.VirtualType=VM_MASTER
PB10.Mode=Enable Chip Select for each bank
CORTEX_M7.BaseAddress-Cortex_Memory_Protection_Unit_Region3_Settings=0x20040000
PG4.Signal=GPIO_Output
PC12.Signal=UART5_TX
PG6.GPIO_Label=SEG_G
SPI5.DataSize=SPI_DATASIZE_8BIT
CORTEX_M7.PREFETCH_ENABLE=1
PK6.GPIO_Label=BTN2
DSIHOST_D1P.Mode=DSIHost_Video
PC6.GPIO_Label=GPIO1
CORTEX_M7.AccessPermission-Cortex_Memory_Protection_Unit_Region2_Settings=MPU_REGION_FULL_ACCESS
SPI5.CLKPhase=SPI_PHASE_2EDGE
PI6.GPIO_Label=ENC_CHB
PC5.Mode=RMII
PB13.Signal=CAN2_TX
PG13.Signal=ETH_TXD0
TIM3.Channel-PWM\ Generation4\ CH4=TIM_CHANNEL_4
RCC.SYSCLKSource=RCC_SYSCLKSOURCE_PLLCLK
PJ13.GPIO_Label=SEG_SEL1
PH5.Signal=SPI5_NSS
DSIHOST.DataLaneHS2LPTime=18
I2C4.Timing=0x20404768
PE2.Mode=SAI_A_MasterWithClock
PD4.Signal=USART2_RTS
DSIHOST_CKP.Mode=DSIHost_Video
PH1/OSC_OUT.Signal=RCC_OSC_OUT
PB6.Mode=I2C
PC3.Signal=ADCx_IN13
PE5.Signal=SAI1_SCK_A
PI3.Mode=Slave_12_bits_External_Synchro
PI6.Signal=S_TIM8_CH2
PI3.Signal=DCMI_D10
SPI2.CalculateBaudRate=6.75 MBits/s
SH.S_TIM4_CH2.0=TIM4_CH2,PWM Generation2 CH2
PE2.Signal=SAI1_MCLK_A
PF8.Mode=Dual_Bank
PD3.Mode=CTS_RTS
PE10.Signal=QUADSPI_BK2_IO3
ADC1.SamplingTime-0\#ChannelRegularConversion=ADC_SAMPLETIME_3CYCLES
DSIHOST.LPVerticalFrontPorchEnable=DSI_LP_VFP_ENABLE
PE9.Mode=Dual_Bank
PD4.Mode=CTS_RTS
PF14.Signal=I2C4_SCL
CORTEX_M7.Enable-Cortex_Memory_Protection_Unit_Region1_Settings=MPU_REGION_ENABLE
VP_DMA2D_VS_DMA2D.Mode=DMA2D_Activate
DSIHOST.HorizontalSyncActive=11
PI11.Signal=GPIO_Input
CAN1.CalculateTimeBit=1481.48
SPI5.VirtualType=VM_MASTER
CORTEX_M7.IsBufferable-Cortex_Memory_Protection_Unit_Region0_Settings=MPU_ACCESS_BUFFERABLE
PC4.Mode=RMII
CAN1.CalculateTimeQuantum=296.2962962962963
PI10.GPIO_Label=LPS22HBTR_INT
DSIHOST.DataLaneLP2HSTime=17
PH15.Signal=DCMI_D11
ADC1.Rank-0\#ChannelRegularConversion=1
PD9.GPIO_Label=APA102_EN
PI4.Mode=Slave_12_bits_External_Synchro
PG9.Signal=DCMI_VSYNC
CORTEX_M7.IsBufferable-Cortex_Memory_Protection_Unit_Region2_Settings=MPU_ACCESS_BUFFERABLE
CAN1.CalculateBaudRate=675000
PE1.Mode=Asynchronous
CORTEX_M7.Enable-Cortex_Memory_Protection_Unit_Region4_Settings=MPU_REGION_ENABLE
PE10.Mode=Dual_Bank
PC6.Signal=S_TIM3_CH1
DSIHOST.ClockLaneLP2HSTime=36
PC0.Signal=ADCx_IN10
RCC.APB1CLKDivider=RCC_HCLK_DIV4
PI2.Mode=Slave_12_bits_External_Synchro
SH.S_TIM8_CH2.0=TIM8_CH2,Encoder_Interface
PG10.Signal=GPIO_Input
PE8.Mode=Dual_Bank
TIM3.Channel-PWM\ Generation3\ CH3=TIM_CHANNEL_3
PF1.Mode=I2C
PB11.Mode=RMII
PA9.Signal=SPI2_SCK
I2C1.Timing=0x20404768
CORTEX_M7.BaseAddress-Cortex_Memory_Protection_Unit_Region0_Settings=0x20020000
SPI4.VirtualNSS=VM_NSSHARD
PB10.Signal=QUADSPI_BK1_NCS
PJ15.Signal=GPIO_Output
TIM8.AutoReloadPreload=TIM_AUTORELOAD_PRELOAD_DISABLE
PI9.GPIO_Label=ICM_42605_INT1
PH6.Mode=Full_Duplex_Master
PH14.Mode=Slave_12_bits_External_Synchro
PA1.Mode=RMII
PE8.Signal=QUADSPI_BK2_IO1
PI1.Signal=DCMI_D8
CORTEX_M7.AccessPermission-Cortex_Memory_Protection_Unit_Region0_Settings=MPU_REGION_FULL_ACCESS
PA13.Mode=Trace_Asynchronous_SW
ADC3.Channel-1\#ChannelRegularConversion=ADC_CHANNEL_15
PA4.Signal=COMP_DAC1_group
PB5.Signal=GPIO_Input
PD11.Signal=GPIO_Output
PA11.Signal=CAN1_RX
TIM5.Channel-PWM\ Generation1\ CH1=TIM_CHANNEL_1
PK3.GPIO_Label=ENC_INT
PF6.Mode=Dual_Bank
PF9.Signal=QUADSPI_BK1_IO1
TIM3.Channel-PWM\ Generation2\ CH2=TIM_CHANNEL_2
PB8.Mode=Slave_12_bits_External_Synchro
PA8.Mode=I2C
SPI2.DataSize=SPI_DATASIZE_8BIT
PG3.GPIO_Label=SEG_D
PB0.Signal=S_TIM3_CH3
PC1.Signal=ETH_MDC
PG10.GPIO_Label=BTN_JS0
PK7.Signal=GPIO_Input
RCC.CortexFreq_Value=216000000
PG6.Signal=GPIO_Output
ADC2.Channel-0\#ChannelRegularConversion=ADC_CHANNEL_13
SPI4.Direction=SPI_DIRECTION_2LINES
I2C2.Timing=0x20404768
TIM8.EncoderMode=TIM_ENCODERMODE_TI12
PA0/WKUP.Signal=S_TIM5_CH1
PB0.GPIO_Label=GPIO2
PI5.GPIO_Label=ENC_CHA
PC13.GPIO_Label=TCS34725FN_INT
PK5.GPIO_Label=BTN1
PB11.Signal=ETH_TX_EN
PI14.GPIO_Label=TC78H660FTG_STBY
ProjectManager.StackSize=0x400
PA12.Signal=CAN1_TX
SPI2.CLKPolarity=SPI_POLARITY_HIGH
PE11.Mode=NSS_Signal_Hard_Output
SPI4.Mode=SPI_MODE_MASTER
DSIHOST.LPVerticalActiveEnable=DSI_LP_VACT_ENABLE
PG11.GPIO_PuPd=GPIO_PULLUP
PH0/OSC_IN.Mode=HSE-External-Oscillator
PD11.GPIO_Label=DSI_RESET
RCC.HCLKFreq_Value=216000000
PI13.Signal=GPIO_Input
DSIHOST.VerticalFrontPorch=20
SPI4.CLKPolarity=SPI_POLARITY_HIGH
RCC.AHBFreq_Value=216000000
SPI2.BaudRatePrescaler=SPI_BAUDRATEPRESCALER_8
DSIHOST_D1N.Mode=DSIHost_Video
ADC3.SamplingTime-1\#ChannelRegularConversion=ADC_SAMPLETIME_3CYCLES
USART2.VirtualMode-Asynchronous=VM_ASYNC
PI8.Signal=GPIO_Input
CORTEX_M7.IsCacheable-Cortex_Memory_Protection_Unit_Region2_Settings=MPU_ACCESS_CACHEABLE
PE13.Signal=SPI4_MISO
PI5.Signal=S_TIM8_CH1
PI0.Signal=GPIO_Output
PA10.GPIO_Label=HEARTBEAT
PG13.Mode=RMII
PE4.Mode=SAI_A_MasterWithClock
PH1/OSC_OUT.Mode=HSE-External-Oscillator
PE4.Signal=SAI1_FS_A
SPI4.BaudRatePrescaler=SPI_BAUDRATEPRESCALER_16
PF15.Mode=I2C
PH7.Mode=Full_Duplex_Master
SPI5.BaudRatePrescaler=SPI_BAUDRATEPRESCALER_16
PJ12.Signal=GPIO_Output
CORTEX_M7.BaseAddress-Cortex_Memory_Protection_Unit_Region1_Settings=0x08000000
PC14/OSC32_IN.Signal=RCC_OSC32_IN
PJ1.Signal=GPIO_Output
PI12.GPIO_Label=TC78H660FTG_MODE
SPI2.CLKPhase=SPI_PHASE_2EDGE
ADC3.ClockPrescaler=ADC_CLOCK_SYNC_PCLK_DIV6
RCC.PLLSAIN=384
PF5.Signal=ADC3_IN15
RCC.PLLSAIP=RCC_PLLSAIP_DIV8
RCC.PLLSAIR=7
PH7.Signal=SPI5_MISO
RCC.PLLSAIQ=6
PJ3.GPIO_Label=LD3
SPI2.Direction=SPI_DIRECTION_2LINES
PF0.Signal=I2C2_SDA
ADC2.Rank-0\#ChannelRegularConversion=1
PE3.Mode=SAI_B_SyncSlave
ADC2.ClockPrescaler=ADC_CLOCK_SYNC_PCLK_DIV6
RCC.PLLSourceVirtual=RCC_PLLSOURCE_HSE
TIM4.Channel-PWM\ Generation1\ CH1=TIM_CHANNEL_1
SH.COMP_DAC1_group.0=DAC_OUT1,DAC_OUT1
CORTEX_M7.CPU_ICache=Enabled
PA7.Mode=RMII
PB9.GPIO_Label=LCD_BL_CTRL
PH11.Signal=DCMI_D2
PG3.Signal=GPIO_Output
PG1.Signal=GPIO_Output
SH.S_TIM4_CH4.0=TIM4_CH4,PWM Generation4 CH4
CORTEX_M7.IsShareable-Cortex_Memory_Protection_Unit_Region3_Settings=MPU_ACCESS_SHAREABLE
PC4.Signal=ETH_RXD0
PI10.Signal=GPIO_Input
PD5.Signal=USART2_TX
VP_RNG_VS_RNG.Mode=RNG_Activate
VP_TIM11_VS_ClockSourceINT.Mode=Enable_Timer
PF7.Mode=Dual_Bank
CORTEX_M7.IsBufferable-Cortex_Memory_Protection_Unit_Region4_Settings=MPU_ACCESS_BUFFERABLE
ProjectManager.TargetToolchain=STM32CubeIDE
DSIHOST.VerticalBackPorch=20
PE11.Signal=SPI4_NSS
SH.S_TIM3_CH2.0=TIM3_CH2,PWM Generation2 CH2
PG14.Signal=ETH_TXD1
PG1.GPIO_Label=SEG_B
DSIHOST.NumberOfLanes=DSI_TWO_DATA_LANES
PH0/OSC_IN.Signal=RCC_OSC_IN
TIM4.Channel-PWM\ Generation2\ CH2=TIM_CHANNEL_2
RCC.APB2Freq_Value=108000000
PF10.Signal=QUADSPI_CLK
PE14.Mode=Full_Duplex_Master
CORTEX_M7.IsShareable-Cortex_Memory_Protection_Unit_Region0_Settings=MPU_ACCESS_SHAREABLE
CAN2.CalculateTimeQuantum=296.2962962962963
PF15.Signal=I2C4_SDA
SPI4.CalculateBaudRate=6.75 MBits/s
PE6.Signal=SAI1_SD_A
Mcu.Name=STM32F769B(G-I)Tx
PD0.Mode=Asynchronous
CORTEX_M7.Size-Cortex_Memory_Protection_Unit_Region0_Settings=MPU_REGION_SIZE_128KB
PA2.Signal=ETH_MDIO
DSIHOST_CKN.Mode=DSIHost_Video
CORTEX_M7.AccessPermission-Cortex_Memory_Protection_Unit_Region1_Settings=MPU_REGION_FULL_ACCESS
PH15.Mode=Slave_12_bits_External_Synchro
PD14.Signal=S_TIM4_CH3
PB3.Signal=SYS_JTDO-SWO
PE7.Mode=Dual_Bank
PA12.Mode=CAN_Activate
PC15/OSC32_OUT.Mode=LSE-External-Oscillator
SAI1.Instance-SAI_B_SyncSlave=SAI$Index_Block_B
PB7.Mode=I2C
PA14.Signal=SYS_JTCK-SWCLK
SH.ADCx_IN10.0=ADC1_IN10,IN10
PF0.Mode=I2C
DSIHOST_D0N.Signal=DSIHOST_D0N
VP_LTDC_DSIMode.Mode=RGB888
CORTEX_M7.Size-Cortex_Memory_Protection_Unit_Region3_Settings=MPU_REGION_SIZE_128KB
ADC1.NbrOfConversionFlag=1
PI15.Signal=GPIO_Output
PB8.Signal=DCMI_D6
PC9.Signal=I2C3_SDA
RCC.APB1Freq_Value=54000000
CORTEX_M7.AccessPermission-Cortex_Memory_Protection_Unit_Region4_Settings=MPU_REGION_FULL_ACCESS
DSIHOST.LPLargestPacketSize=28
ADC1.ClockPrescaler=ADC_CLOCK_SYNC_PCLK_DIV6
PE0.Mode=Asynchronous
SPI5.Direction=SPI_DIRECTION_2LINES
SH.S_TIM3_CH4.0=TIM3_CH4,PWM Generation4 CH4
PA7.Signal=ETH_CRS_DV

// file: Core/Src/main.c
/* USER CODE BEGIN Header */
/**
  ******************************************************************************
  * @file           : main.c
  * @brief          : Main program body
  ******************************************************************************
  * @attention
  *
  * <h2><center>&copy; Copyright (c) 2021 STMicroelectronics.
  * All rights reserved.</center></h2>
  *
  * This software component is licensed by ST under BSD 3-Clause license,
  * the "License"; You may not use this file except in compliance with the
  * License. You may obtain a copy of the License at:
  *                        opensource.org/licenses/BSD-3-Clause
  *
  ******************************************************************************
  */
/* USER CODE END Header */
#include "main.h"
#include "adc.h"
#include "can.h"
#include "crc.h"
#include "dac.h"
#include "dcmi.h"
#include "dma2d.h"
#include "dsihost.h"
#include "eth.h"
#include "i2c.h"
#include "ltdc.h"
#include "quadspi.h"
#include "rng.h"
#include "sai.h"
#include "spi.h"
#include "tim.h"
#include "usart.h"
#include "gpio.h"

/* USER CODE BEGIN Includes */
#include "stdio.h"
/* USER CODE END Includes */

void SystemClock_Config(void);
static void MPU_Config(void);
/* USER CODE BEGIN PFP */
void mandelbrot_main(void);
/* USER CODE END PFP */

int main(void)
{

  /* MPU Configuration--------------------------------------------------------*/
  MPU_Config();

  /* Enable I-Cache---------------------------------------------------------*/
  SCB_EnableICache();

  /* Enable D-Cache---------------------------------------------------------*/
  SCB_EnableDCache();

  /* MCU Configuration--------------------------------------------------------*/

  /* Reset of all peripherals, Initializes the Flash interface and the Systick. */
  HAL_Init();

  /* Configure the system clock */
  SystemClock_Config();

  /* Initialize all configured peripherals */
  MX_GPIO_Init();
  MX_ADC1_Init();
  MX_CAN1_Init();
  MX_DAC_Init();
  MX_DCMI_Init();
  MX_ETH_Init();
  MX_I2C2_Init();
  MX_I2C4_Init();
  MX_QUADSPI_Init();
  MX_SPI2_Init();
  MX_SPI4_Init();
  MX_SPI5_Init();
  MX_TIM3_Init();
  MX_TIM4_Init();
  MX_TIM8_Init();
  MX_UART4_Init();
  MX_UART8_Init();
  MX_USART2_UART_Init();
  MX_CAN2_Init();
  MX_I2C1_Init();
  MX_I2C3_Init();
  MX_TIM12_Init();
  MX_TIM11_Init();
  MX_ADC3_Init();
  MX_ADC2_Init();
  MX_SAI1_Init();
  MX_TIM5_Init();
  MX_UART5_Init();
  MX_RNG_Init();
  MX_CRC_Init();
  MX_DMA2D_Init();
  MX_DSIHOST_DSI_Init();
  MX_LTDC_Init();
  /* USER CODE BEGIN 2 */

  mandelbrot_main();

  /* USER CODE END 2 */

  /* Infinite loop */
  while (1)
  {

  }
}

void SystemClock_Config(void)
{
  RCC_OscInitTypeDef RCC_OscInitStruct = {0};
  RCC_ClkInitTypeDef RCC_ClkInitStruct = {0};
  RCC_PeriphCLKInitTypeDef PeriphClkInitStruct = {0};

  /** Configure LSE Drive Capability
  */
  HAL_PWR_EnableBkUpAccess();
  /** Configure the main internal regulator output voltage
  */
  __HAL_RCC_PWR_CLK_ENABLE();
  __HAL_PWR_VOLTAGESCALING_CONFIG(PWR_REGULATOR_VOLTAGE_SCALE1);
  /** Initializes the RCC Oscillators according to the specified parameters
  * in the RCC_OscInitTypeDef structure.
  */
  RCC_OscInitStruct.OscillatorType = RCC_OSCILLATORTYPE_HSE;
  RCC_OscInitStruct.HSEState = RCC_HSE_ON;
  RCC_OscInitStruct.PLL.PLLState = RCC_PLL_ON;
  RCC_OscInitStruct.PLL.PLLSource = RCC_PLLSOURCE_HSE;
  RCC_OscInitStruct.PLL.PLLM = 24;
  RCC_OscInitStruct.PLL.PLLN = 432;
  RCC_OscInitStruct.PLL.PLLP = RCC_PLLP_DIV2;
  RCC_OscInitStruct.PLL.PLLQ = 8;
  if (HAL_RCC_OscConfig(&RCC_OscInitStruct) != HAL_OK)
  {
    Error_Handler();
  }
  /** Activate the Over-Drive mode
  */
  if (HAL_PWREx_EnableOverDrive() != HAL_OK)
  {
    Error_Handler();
  }
  /** Initializes the CPU, AHB and APB buses clocks
  */
  RCC_ClkInitStruct.ClockType = RCC_CLOCKTYPE_HCLK|RCC_CLOCKTYPE_SYSCLK
                              |RCC_CLOCKTYPE_PCLK1|RCC_CLOCKTYPE_PCLK2;
  RCC_ClkInitStruct.SYSCLKSource = RCC_SYSCLKSOURCE_PLLCLK;
  RCC_ClkInitStruct.AHBCLKDivider = RCC_SYSCLK_DIV1;
  RCC_ClkInitStruct.APB1CLKDivider = RCC_HCLK_DIV4;
  RCC_ClkInitStruct.APB2CLKDivider = RCC_HCLK_DIV2;

  if (HAL_RCC_ClockConfig(&RCC_ClkInitStruct, FLASH_LATENCY_7) != HAL_OK)
  {
    Error_Handler();
  }
  PeriphClkInitStruct.PeriphClockSelection = RCC_PERIPHCLK_LTDC|RCC_PERIPHCLK_USART2
                              |RCC_PERIPHCLK_UART4|RCC_PERIPHCLK_UART5
                              |RCC_PERIPHCLK_UART8|RCC_PERIPHCLK_SAI1
                              |RCC_PERIPHCLK_I2C1|RCC_PERIPHCLK_I2C2
                              |RCC_PERIPHCLK_I2C3|RCC_PERIPHCLK_I2C4
                              |RCC_PERIPHCLK_CLK48;
  PeriphClkInitStruct.PLLSAI.PLLSAIN = 384;
  PeriphClkInitStruct.PLLSAI.PLLSAIR = 7;
  PeriphClkInitStruct.PLLSAI.PLLSAIQ = 6;
  PeriphClkInitStruct.PLLSAI.PLLSAIP = RCC_PLLSAIP_DIV8;
  PeriphClkInitStruct.PLLSAIDivQ = 1;
  PeriphClkInitStruct.PLLSAIDivR = RCC_PLLSAIDIVR_2;
  PeriphClkInitStruct.Sai1ClockSelection = RCC_SAI1CLKSOURCE_PLLSAI;
  PeriphClkInitStruct.Usart2ClockSelection = RCC_USART2CLKSOURCE_PCLK1;
  PeriphClkInitStruct.Uart4ClockSelection = RCC_UART4CLKSOURCE_PCLK1;
  PeriphClkInitStruct.Uart5ClockSelection = RCC_UART5CLKSOURCE_PCLK1;
  PeriphClkInitStruct.Uart8ClockSelection = RCC_UART8CLKSOURCE_PCLK1;
  PeriphClkInitStruct.I2c1ClockSelection = RCC_I2C1CLKSOURCE_PCLK1;
  PeriphClkInitStruct.I2c2ClockSelection = RCC_I2C2CLKSOURCE_PCLK1;
  PeriphClkInitStruct.I2c3ClockSelection = RCC_I2C3CLKSOURCE_PCLK1;
  PeriphClkInitStruct.I2c4ClockSelection = RCC_I2C4CLKSOURCE_PCLK1;
  PeriphClkInitStruct.Clk48ClockSelection = RCC_CLK48SOURCE_PLLSAIP;
  if (HAL_RCCEx_PeriphCLKConfig(&PeriphClkInitStruct) != HAL_OK)
  {
    Error_Handler();
  }
}

/* MPU Configuration */

void MPU_Config(void)
{
  MPU_Region_InitTypeDef MPU_InitStruct = {0};

  /* Disables the MPU */
  HAL_MPU_Disable();
  /** Initializes and configures the Region and the memory to be protected
  */
  MPU_InitStruct.Enable = MPU_REGION_ENABLE;
  MPU_InitStruct.Number = MPU_REGION_NUMBER0;
  MPU_InitStruct.BaseAddress = 0x20020000;
  MPU_InitStruct.Size = MPU_REGION_SIZE_128KB;
  MPU_InitStruct.SubRegionDisable = 0x0;
  MPU_InitStruct.TypeExtField = MPU_TEX_LEVEL0;
  MPU_InitStruct.AccessPermission = MPU_REGION_FULL_ACCESS;
  MPU_InitStruct.DisableExec = MPU_INSTRUCTION_ACCESS_ENABLE;
  MPU_InitStruct.IsShareable = MPU_ACCESS_SHAREABLE;
  MPU_InitStruct.IsCacheable = MPU_ACCESS_NOT_CACHEABLE;
  MPU_InitStruct.IsBufferable = MPU_ACCESS_BUFFERABLE;

  HAL_MPU_ConfigRegion(&MPU_InitStruct);
  /** Initializes and configures the Region and the memory to be protected
  */
  MPU_InitStruct.Number = MPU_REGION_NUMBER1;
  MPU_InitStruct.BaseAddress = 0x08000000;
  MPU_InitStruct.Size = MPU_REGION_SIZE_2MB;
  MPU_InitStruct.IsCacheable = MPU_ACCESS_CACHEABLE;

  HAL_MPU_ConfigRegion(&MPU_InitStruct);
  /** Initializes and configures the Region and the memory to be protected
  */
  MPU_InitStruct.Number = MPU_REGION_NUMBER2;
  MPU_InitStruct.BaseAddress = 0x20000000;
  MPU_InitStruct.Size = MPU_REGION_SIZE_128KB;

  HAL_MPU_ConfigRegion(&MPU_InitStruct);
  /** Initializes and configures the Region and the memory to be protected
  */
  MPU_InitStruct.Number = MPU_REGION_NUMBER3;
  MPU_InitStruct.BaseAddress = 0x20040000;
  MPU_InitStruct.IsCacheable = MPU_ACCESS_NOT_CACHEABLE;

  HAL_MPU_ConfigRegion(&MPU_InitStruct);
  /** Initializes and configures the Region and the memory to be protected
  */
  MPU_InitStruct.Number = MPU_REGION_NUMBER4;
  MPU_InitStruct.BaseAddress = 0x20060000;

  HAL_MPU_ConfigRegion(&MPU_InitStruct);
  /* Enables the MPU */
  HAL_MPU_Enable(MPU_PRIVILEGED_DEFAULT);

}

void Error_Handler(void)
{
  __disable_irq();
  while (1)
  {
  }
}

/************************ (C) COPYRIGHT STMicroelectronics *****END OF FILE****/
